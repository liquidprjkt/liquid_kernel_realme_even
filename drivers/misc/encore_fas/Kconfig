## drivers/misc/encore_fas/Kconfig
```kconfig
config ENCORE_FAS_FRAMETIME
	tristate "Encore Tweaks FAS kernel driver"
	depends on UPROBES
	default n
	help
	  Uprobe-based jank detection misc device for Encore Tweaks (/dev/encore_fas).
```
